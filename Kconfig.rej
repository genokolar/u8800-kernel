## Kconfig.rej
```kconfig
--- Kconfig	2010-11-18 23:32:26.000000000 +0100
+++ Kconfig	2009-12-03 04:51:21.000000000 +0100
@@ -599,18 +599,6 @@
 
 endif # CGROUPS
 
-config SCHED_AUTOGROUP
-	bool "Automatic process group scheduling"
-	select CGROUPS
-	select CGROUP_SCHED
-	select FAIR_GROUP_SCHED
-	help
-	  This option optimizes the scheduler for common desktop workloads by
-	  automatically creating and populating task groups.  This separation
-	  of workloads isolates aggressive CPU burners (like build jobs) from
-	  desktop applications.  Task group autogeneration is currently based
-	  upon task tty association.
-
 config MM_OWNER
 	bool
 
```
